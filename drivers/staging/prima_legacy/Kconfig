## drivers/staging/prima_legacy/Kconfig
```kconfig
comment "Qualcomm Atheros Prima Legacy WLAN module"
config PRIMA_WLAN_LEGACY
	tristate "Qualcomm Atheros Prima Legacy WLAN module"
	default n
	help
	Add support for the Qualcomm Atheros Prima Legacy WLAN module

#	depends on WLAN
#	depends on CFG80211
#        depends on WCNSS_CORE

if PRIMA_WLAN_LEGACY != n

config PRIMA_WLAN_BTAMP_LEGACY
	bool "Enable the Prima Legacy WLAN BT-AMP feature"
	default n

endif # PRIMA_WLAN
```
